## zephyrproject/zephyr-workspace/build/Kconfig/boards/Kconfig.qemu_x86
```kconfig
# Load board Kconfig descriptions.
osource "/home/sreevas2003/zephyrproject/zephyr-workspace/zephyr/boards/qemu/x86/Kconfig.qemu_x86"
```
