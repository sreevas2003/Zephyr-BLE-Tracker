## zephyrproject/apps/ble_asset_tracking/readings_on_table/base/build/Kconfig/boards/Kconfig.esp32_devkitc
```kconfig
# Load board Kconfig descriptions.
osource "/home/sreevas2003/zephyrproject/zephyr-workspace/zephyr/boards/espressif/esp32_devkitc/Kconfig.esp32_devkitc"
```

## zephyrproject/zephyr-workspace/ble_asset_tracking/simple_with_bar/beacon/build/Kconfig/boards/Kconfig.defconfig
```kconfig
# Load Zephyr board defconfig descriptions.
osource "/home/sreevas2003/zephyrproject/zephyr-workspace/zephyr/boards/espressif/esp32_devkitc/Kconfig.defconfig"
```

## zephyrproject/zephyr-workspace/build_beacon/Kconfig/arch/Kconfig
```kconfig
# Load Zephyr Arch Kconfig descriptions.
osource "/home/sreevas2003/zephyrproject/zephyr-workspace/zephyr/arch/rx/Kconfig"
osource "/home/sreevas2003/zephyrproject/zephyr-workspace/zephyr/arch/x86/Kconfig"
osource "/home/sreevas2003/zephyrproject/zephyr-workspace/zephyr/arch/xtensa/Kconfig"
osource "/home/sreevas2003/zephyrproject/zephyr-workspace/zephyr/arch/sparc/Kconfig"
osource "/home/sreevas2003/zephyrproject/zephyr-workspace/zephyr/arch/riscv/Kconfig"
osource "/home/sreevas2003/zephyrproject/zephyr-workspace/zephyr/arch/posix/Kconfig"
osource "/home/sreevas2003/zephyrproject/zephyr-workspace/zephyr/arch/mips/Kconfig"
osource "/home/sreevas2003/zephyrproject/zephyr-workspace/zephyr/arch/arm64/Kconfig"
osource "/home/sreevas2003/zephyrproject/zephyr-workspace/zephyr/arch/arm/Kconfig"
osource "/home/sreevas2003/zephyrproject/zephyr-workspace/zephyr/arch/arc/Kconfig"
```
